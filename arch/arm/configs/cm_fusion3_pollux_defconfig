## arch/arm/configs/cm_fusion3_pollux_defconfig
```kconfig
CONFIG_AEABI=y
CONFIG_ALLOW_CPU_ALIGNMENT=y
CONFIG_ANDROID_BINDER_IPC=y
CONFIG_ANDROID_LOGGER=y
CONFIG_ANDROID_LOW_MEMORY_KILLER=y
CONFIG_ANDROID_RAM_CONSOLE=y
CONFIG_ANDROID_TIMED_GPIO=y
CONFIG_ANDROID=y
CONFIG_ARCH_APQ8064=y
CONFIG_ARCH_MSM8960=y
CONFIG_ARCH_MSM=y
CONFIG_ARM_FLUSH_CONSOLE_ON_RESTART=y
# CONFIG_ARM_PATCH_PHYS_VIRT is not set
CONFIG_ARM_UNWIND=y
CONFIG_ASHMEM=y
CONFIG_AUDIT=y
CONFIG_BACKLIGHT_CLASS_DEVICE=y
CONFIG_BACKLIGHT_LCD_SUPPORT=y
CONFIG_BACKLIGHT_LP855X=y
# CONFIG_BATTERY_MSM is not set
CONFIG_BLK_DEV_DM=y
CONFIG_BLK_DEV_INITRD=y
CONFIG_BLK_DEV_LOOP=y
CONFIG_BLK_DEV_RAM_SIZE=8192
CONFIG_BLK_DEV_RAM=y
CONFIG_BLK_DEV_SD=y
CONFIG_BRIDGE=y
CONFIG_BT_BNEP_MC_FILTER=y
CONFIG_BT_BNEP_PROTO_FILTER=y
CONFIG_BT_BNEP=y
CONFIG_BT_HCIUART_ATH3K=y
CONFIG_BT_HCIUART_H4=y
CONFIG_BT_HCIUART_IBS=y
CONFIG_BT_HCIUART=y
CONFIG_BT_HIDP=y
CONFIG_BT_RFCOMM_TTY=y
CONFIG_BT_RFCOMM=y
CONFIG_BT=y
CONFIG_CC_OPTIMIZE_FOR_SIZE=y
CONFIG_CC_STACKPROTECTOR=y
CONFIG_CFG80211_INTERNAL_REGDB=y
# CONFIG_CFG80211_WEXT is not set
CONFIG_CFG80211=y
CONFIG_CGROUP_CPUACCT=y
# CONFIG_CGROUP_DEBUG is not set
CONFIG_CGROUP_FREEZER=y
CONFIG_CGROUP_SCHED=y
CONFIG_CGROUPS=y
CONFIG_CHR_DEV_SCH=y
CONFIG_CHR_DEV_SG=y
CONFIG_CIFS_POSIX=y
CONFIG_CIFS_XATTR=y
CONFIG_CIFS=y
CONFIG_CLS_U32_MARK=y
CONFIG_CMA=y
CONFIG_COMPACTION=y
# CONFIG_CORE_DUMP_DEFAULT_ELF_HEADERS is not set
CONFIG_CP_ACCESS=y
# CONFIG_CPU_FREQ_DEFAULT_GOV_ABYSSPLUGV2 is not set
# CONFIG_CPU_FREQ_DEFAULT_GOV_ADAPTIVE is not set
# CONFIG_CPU_FREQ_DEFAULT_GOV_BADASS is not set
# CONFIG_CPU_FREQ_DEFAULT_GOV_CONSERVATIVE is not set
# CONFIG_CPU_FREQ_DEFAULT_GOV_DANCEDANCE is not set
# CONFIG_CPU_FREQ_DEFAULT_GOV_HYPER is not set
# CONFIG_CPU_FREQ_DEFAULT_GOV_INTELLIACTIVE is not set
# CONFIG_CPU_FREQ_DEFAULT_GOV_INTELLIDEMAND is not set
# CONFIG_CPU_FREQ_DEFAULT_GOV_INTERACTIVE is not set
# CONFIG_CPU_FREQ_DEFAULT_GOV_LAZY is not set
# CONFIG_CPU_FREQ_DEFAULT_GOV_LIONHEART is not set
# CONFIG_CPU_FREQ_DEFAULT_GOV_NIGHTMARE is not set
# CONFIG_CPU_FREQ_DEFAULT_GOV_ONDEMAND is not set
# CONFIG_CPU_FREQ_DEFAULT_GOV_ONDEMANDPLUS is not set
# CONFIG_CPU_FREQ_DEFAULT_GOV_PEGASUSQ is not set
# CONFIG_CPU_FREQ_DEFAULT_GOV_PERFORMANCE is not set
# CONFIG_CPU_FREQ_DEFAULT_GOV_POWERSAVE is not set
# CONFIG_CPU_FREQ_DEFAULT_GOV_PRESERVATIVE is not set
# CONFIG_CPU_FREQ_DEFAULT_GOV_SMARTASSH3 is not set
# CONFIG_CPU_FREQ_DEFAULT_GOV_UBERDEMAND is not set
# CONFIG_CPU_FREQ_DEFAULT_GOV_WHEATLEY is not set
CONFIG_CPU_FREQ_GOV_ABYSSPLUGV2=y
CONFIG_CPU_FREQ_GOV_ADAPTIVE=y
CONFIG_CPU_FREQ_GOV_BADASS_2_PHASE=y
CONFIG_CPU_FREQ_GOV_BADASS_3_PHASE=y
CONFIG_CPU_FREQ_GOV_BADASS_ALLOW_BYPASS=y
CONFIG_CPU_FREQ_GOV_BADASS=y
CONFIG_CPU_FREQ_GOV_CONSERVATIVE=y
CONFIG_CPU_FREQ_GOV_DANCEDANCE=y
CONFIG_CPU_FREQ_GOV_HYPER=y
CONFIG_CPU_FREQ_GOV_INTELLIACTIVE=y
CONFIG_CPU_FREQ_GOV_INTELLIDEMAND=y
CONFIG_CPU_FREQ_GOV_INTERACTIVE=y
CONFIG_CPU_FREQ_GOV_LAZY=y
CONFIG_CPU_FREQ_GOV_LIONHEART=y
CONFIG_CPU_FREQ_GOV_LULZACTIVE=y
CONFIG_CPU_FREQ_GOV_NIGHTMARE=y
CONFIG_CPU_FREQ_GOV_ONDEMANDPLUS=y
CONFIG_CPU_FREQ_GOV_ONDEMANDX=y
CONFIG_CPU_FREQ_GOV_ONDEMAND=y
CONFIG_CPU_FREQ_GOV_PEGASUSQ=y
CONFIG_CPU_FREQ_GOV_POWERSAVE=y
CONFIG_CPU_FREQ_GOV_PRESERVATIVE=y
CONFIG_CPU_FREQ_GOV_SMARTASSH3=y
CONFIG_CPU_FREQ_GOV_UBERDEMAND=y
CONFIG_CPU_FREQ_GOV_WHEATLEY=y
CONFIG_CPU_FREQ=y
CONFIG_CPU_IDLE=y
CONFIG_CPU_VOLTAGE_TABLE=y
CONFIG_CRASH_NOTES=y
CONFIG_CRYPTO_AES_ARM=y
CONFIG_CRYPTO_NULL=y
CONFIG_CRYPTO_SHA1_ARM=y
CONFIG_CRYPTO_TWOFISH=y
CONFIG_CRYPTO_XCBC=y
# CONFIG_DEBUG_GPIO is not set
# CONFIG_DEBUG_INFO is not set
# CONFIG_DEBUG_MEMORY_INIT is not set
# CONFIG_DEBUG_PREEMPT is not set
CONFIG_DECOMPRESS_LZ4=y
# CONFIG_DEFAULT_BFQ is not set
# CONFIG_DEFAULT_CFQ is not set
# CONFIG_DEFAULT_DEADLINE is not set
# CONFIG_DEFAULT_FIFO is not set
CONFIG_DEFAULT_FIOPS=y
# CONFIG_DEFAULT_NOOP is not set
# CONFIG_DEFAULT_ROW is not set
# CONFIG_DEFAULT_SIO is not set
# CONFIG_DEFAULT_TRIPNDROID is not set
# CONFIG_DEFAULT_VR is not set
# CONFIG_DEFAULT_ZEN is not set
# CONFIG_DEVKMEM is not set
# CONFIG_DEVMEM is not set
CONFIG_DIAG_CHAR=y
CONFIG_DISABLE_SMPL=y
CONFIG_DM_CRYPT=y
CONFIG_DM_UEVENT=y
CONFIG_DUMMY=y
# CONFIG_DYNAMIC_DEBUG is not set
CONFIG_EFI_PARTITION=y
CONFIG_EMBEDDED=y
CONFIG_ENABLE_DEFAULT_TRACERS=y
CONFIG_EXFAT_FS=y
CONFIG_EXPERIMENTAL=y
CONFIG_EXT2_FS_SECURITY=y
CONFIG_EXT2_FS_XATTR=y
CONFIG_EXT2_FS=y
# CONFIG_EXT3_DEFAULTS_TO_ORDERED is not set
CONFIG_EXT3_FS_SECURITY=y
CONFIG_EXT3_FS=y
CONFIG_EXT4_FS_SECURITY=y
CONFIG_EXT4_FS=y
CONFIG_F2FS_FS_SECURITY=y
CONFIG_F2FS_FS=y
# CONFIG_FB_MSM_BACKLIGHT is not set
CONFIG_FB_MSM_HDMI_MSM_PANEL=y
CONFIG_FB_MSM_LOGO=y
CONFIG_FB_MSM_MDP40=y
CONFIG_FB_MSM_MIPI_NT71391_PANASONIC_VVX10F008B00=y
CONFIG_FB_MSM_NO_MDP_PIPE_CTRL=y
CONFIG_FB_MSM_OVERLAY0_WRITEBACK=y
CONFIG_FB_MSM_OVERLAY1_WRITEBACK=y
CONFIG_FB_MSM_OVERLAY=y
CONFIG_FB_MSM_TRIPLE_BUFFER=y
CONFIG_FB_MSM_WRITEBACK_MSM_PANEL=y
CONFIG_FB_MSM=y
CONFIG_FB_VIRTUAL=y
CONFIG_FB=y
CONFIG_FUSE_FS=y
CONFIG_GENLOCK_MISCDEVICE=y
CONFIG_GENLOCK=y
CONFIG_GPIO_SX150X=y
CONFIG_GPIO_SYSFS=y
CONFIG_HAPTIC_ISA1200=y
CONFIG_HAS_MACH_MEMUTILS=y
CONFIG_HAVE_KERNEL_LZ4=y
CONFIG_HID_APPLE=y
CONFIG_HID_ELECOM=y
# CONFIG_HID_LOGITECH_DJ is not set
CONFIG_HID_LOGITECH=y
CONFIG_HID_MAGICMOUSE=y
CONFIG_HID_MICROSOFT=y
CONFIG_HID_PANTHERLORD=y
CONFIG_HIDRAW=y
CONFIG_HID_SONY=y
CONFIG_HIGHMEM=y
CONFIG_HIGH_RES_TIMERS=y
CONFIG_HW_RANDOM_MSM=y
CONFIG_HW_RANDOM=y
CONFIG_I2C_CHARDEV=y
# CONFIG_I2C_MSM is not set
CONFIG_I2C_QUP=y
CONFIG_I2C=y
CONFIG_IKCONFIG=y
CONFIG_INET6_AH=y
CONFIG_INET6_ESP=y
CONFIG_INET6_IPCOMP=y
CONFIG_INET_AH=y
CONFIG_INET_ESP=y
CONFIG_INET_IPCOMP=y
# CONFIG_INET_LRO is not set
CONFIG_INET=y
CONFIG_INPUT_AKM8963=y
CONFIG_INPUT_BMA250_NG=y
CONFIG_INPUT_BU52031NVX=y
CONFIG_INPUT_EVDEV=y
CONFIG_INPUT_GPIO=y
CONFIG_INPUT_KEYCHORD=y
CONFIG_INPUT_KEYRESET=y
CONFIG_INPUT_MISC=y
# CONFIG_INPUT_MOUSEDEV is not set
CONFIG_INPUT_PMIC8XXX_PWRKEY=y
CONFIG_INPUT_TOUCHSCREEN=y
CONFIG_INPUT_UINPUT=y
CONFIG_INTELLI_PLUG=y
CONFIG_INTELLI_THERMAL=y
CONFIG_ION_MSM=y
CONFIG_ION=y
# CONFIG_IOSCHED_DEADLINE is not set
# CONFIG_IOSCHED_TEST is not set
CONFIG_IP6_NF_FILTER=y
CONFIG_IP6_NF_IPTABLES=y
CONFIG_IP6_NF_MANGLE=y
CONFIG_IP6_NF_RAW=y
CONFIG_IP6_NF_SECURITY=y
CONFIG_IP6_NF_TARGET_REJECT_SKERR=y
CONFIG_IP6_NF_TARGET_REJECT=y
CONFIG_IP_ADVANCED_ROUTER=y
# CONFIG_IPC_NS is not set
CONFIG_IP_MULTIPLE_TABLES=y
CONFIG_IP_NF_ARPFILTER=y
CONFIG_IP_NF_ARP_MANGLE=y
CONFIG_IP_NF_ARPTABLES=y
CONFIG_IP_NF_FILTER=y
CONFIG_IP_NF_IPTABLES=y
CONFIG_IP_NF_MANGLE=y
CONFIG_IP_NF_MATCH_AH=y
CONFIG_IP_NF_MATCH_ECN=y
CONFIG_IP_NF_MATCH_TTL=y
CONFIG_IP_NF_RAW=y
CONFIG_IP_NF_SECURITY=y
CONFIG_IP_NF_TARGET_MASQUERADE=y
CONFIG_IP_NF_TARGET_NETMAP=y
CONFIG_IP_NF_TARGET_REDIRECT=y
CONFIG_IP_NF_TARGET_REJECT_SKERR=y
CONFIG_IP_NF_TARGET_REJECT=y
CONFIG_IP_PNP_DHCP=y
CONFIG_IP_PNP=y
CONFIG_IP_ROUTE_VERBOSE=y
CONFIG_IPV6_MIP6=y
CONFIG_IPV6_MULTIPLE_TABLES=y
CONFIG_IPV6_OPTIMISTIC_DAD=y
CONFIG_IPV6_PRIVACY=y
CONFIG_IPV6_ROUTE_INFO=y
CONFIG_IPV6_ROUTER_PREF=y
CONFIG_IPV6_SUBTREES=y
CONFIG_IPV6=y
CONFIG_IR_GPIO_CIR=y
CONFIG_ISL9519_CHARGER=y
CONFIG_KALLSYMS_ALL=y
CONFIG_KERNEL_LZ4=y
CONFIG_KERNEL_MSM_CONTIG_MEM_REGION=y
CONFIG_KEYBOARD_GPIO=y
CONFIG_KEYBOARD_MATRIX=y
CONFIG_KEYBOARD_PMIC8XXX=y
CONFIG_KGSL_PER_PROCESS_PAGE_TABLE=y
CONFIG_KPROBES=y
CONFIG_KSM=y
CONFIG_L2TP=y
CONFIG_LEDS_LM3533=y
CONFIG_LEDS_TRIGGERS=y
# CONFIG_LEGACY_PTYS is not set
CONFIG_LOCALVERSION="-cm"
CONFIG_LZ4_DECOMPRESS=y
CONFIG_MACH_MSM8960_CDP=y
CONFIG_MACH_SONY_FUSION3=y
CONFIG_MACH_SONY_POLLUX=y
CONFIG_MAGIC_SYSRQ=y
CONFIG_MD=y
CONFIG_MEDIA_CONTROLLER=y
CONFIG_MEDIA_SUPPORT=y
# CONFIG_MEDIA_TUNER_CUSTOMISE is not set
CONFIG_MFD_PM8038_CORE=y
CONFIG_MFD_PM8821_CORE=y
CONFIG_MFD_PM8921_CORE=y
CONFIG_MFD_PM8XXX_BATT_ALARM=y
CONFIG_MFD_PM8XXX_SPK=y
# CONFIG_MMC_BLOCK_BOUNCE is not set
CONFIG_MMC_BLOCK_MINORS=32
CONFIG_MMC_CLKGATE=y
CONFIG_MMC_MSM_SDC1_8_BIT_SUPPORT=y
# CONFIG_MMC_MSM_SDC2_SUPPORT is not set
CONFIG_MMC_MSM_SDC3_POLLUX_DOWN_CLKRATE=y
CONFIG_MMC_MSM_SDC3_SUPPORT=y
CONFIG_MMC_MSM_SDC3_WP_SUPPORT=y
CONFIG_MMC_MSM_SPS_SUPPORT=y
CONFIG_MMC_MSM=y
CONFIG_MMC_PARANOID_SD_INIT=y
CONFIG_MMC_PERF_PROFILING=y
# CONFIG_MMC_TEST is not set
CONFIG_MMC_UNSAFE_RESUME=y
CONFIG_MMC=y
CONFIG_MODULE_FORCE_UNLOAD=y
CONFIG_MODULES=y
CONFIG_MODULE_UNLOAD=y
CONFIG_MODVERSIONS=y
CONFIG_MSM_ACTUATOR=y
CONFIG_MSM_AVS_HW=y
CONFIG_MSM_AVTIMER=y
CONFIG_MSM_BAM_DMUX=y
CONFIG_MSM_BT_POWER=y
CONFIG_MSM_BUS_RPM_MULTI_TIER_ENABLED=y
CONFIG_MSM_BUS_SCALING=y
CONFIG_MSM_CACHE_ERP=y
CONFIG_MSM_CAMERA_SENSOR=y
CONFIG_MSM_CAMERA_V4L2=y
CONFIG_MSM_CSI20_HEADER=y
CONFIG_MSM_DCVS=y
CONFIG_MSM_DLOAD_MODE=y
CONFIG_MSM_EBI_ERP=y
CONFIG_MSM_EEPROM=y
CONFIG_MSM_EVENT_TIMER=y
# CONFIG_MSM_FIQ_SUPPORT is not set
CONFIG_MSM_GEMINI=y
CONFIG_MSM_GSS_SSR_8064=y
CONFIG_MSM_HSIC_SYSMON=y
# CONFIG_MSM_HW3D is not set
CONFIG_MSM_IOMMU=y
CONFIG_MSM_IPC_LOGGING=y
CONFIG_MSM_IPC_ROUTER_SECURITY=y
CONFIG_MSM_IPC_ROUTER_SMD_XPRT=y
CONFIG_MSM_IPC_ROUTER=y
CONFIG_MSM_KGSL_PAGE_TABLE_COUNT=24
CONFIG_MSM_KGSL=y
CONFIG_MSM_KRAIT_TBB_ABORT_HANDLER=y
CONFIG_MSM_L1_ERR_LOG=y
CONFIG_MSM_L1_ERR_PANIC=y
CONFIG_MSM_L2_ERP_2BIT_PANIC=y
CONFIG_MSM_LPASS_8960=y
CONFIG_MSM_MERCURY=y
CONFIG_MSM_MODEM_8960=y
CONFIG_MSM_MODEM_SUBSYSTEM_RESTART_MONITOR=y
CONFIG_MSM_PCIE=y
CONFIG_MSM_PIL_DSPS=y
CONFIG_MSM_PIL_GSS=y
CONFIG_MSM_PIL_QDSP6V4=y
CONFIG_MSM_PIL_RIVA=y
CONFIG_MSM_PIL_TZAPPS=y
CONFIG_MSM_PIL_VIDC=y
# CONFIG_MSM_PROC_COMM is not set
CONFIG_MSM_RMNET_BAM=y
# CONFIG_MSM_RMNET is not set
CONFIG_MSM_RMNET_SMUX=y
CONFIG_MSM_RMNET_USB=y
CONFIG_MSM_RPM_LOG=y
CONFIG_MSM_RPM_RBCPR_STATS_LOG=y
CONFIG_MSM_RPM_STATS_LOG=y
CONFIG_MSM_RTB_SEPARATE_CPUS=y
CONFIG_MSM_RTB=y
CONFIG_MSM_SMD_PKG4=y
CONFIG_MSM_SMD=y
CONFIG_MSM_SSBI=y
# CONFIG_MSM_STACKED_MEMORY is not set
CONFIG_MSM_SUBSYSTEM_RESTART=y
CONFIG_MSM_SYSMON_COMM=y
CONFIG_MSM_TZ_LOG=y
CONFIG_MSM_WATCHDOG=y
CONFIG_MSM_WCNSS_SSR_8960=y
CONFIG_MSM_WFD=y
CONFIG_NAMESPACES=y
CONFIG_NEON=y
CONFIG_NET_CLS_ACT=y
CONFIG_NET_CLS_FLOW=y
CONFIG_NET_CLS_FW=y
CONFIG_NET_CLS_U32=y
CONFIG_NETDEVICES=y
CONFIG_NET_EMATCH_CMP=y
CONFIG_NET_EMATCH_META=y
CONFIG_NET_EMATCH_NBYTE=y
CONFIG_NET_EMATCH_TEXT=y
CONFIG_NET_EMATCH_U32=y
CONFIG_NET_EMATCH=y
CONFIG_NETFILTER_NETLINK_LOG=y
CONFIG_NETFILTER_TPROXY=y
CONFIG_NETFILTER_XT_MATCH_COMMENT=y
CONFIG_NETFILTER_XT_MATCH_CONNLIMIT=y
CONFIG_NETFILTER_XT_MATCH_CONNMARK=y
CONFIG_NETFILTER_XT_MATCH_CONNTRACK=y
CONFIG_NETFILTER_XT_MATCH_DSCP=y
CONFIG_NETFILTER_XT_MATCH_HASHLIMIT=y
CONFIG_NETFILTER_XT_MATCH_HELPER=y
CONFIG_NETFILTER_XT_MATCH_IPRANGE=y
CONFIG_NETFILTER_XT_MATCH_LENGTH=y
CONFIG_NETFILTER_XT_MATCH_LIMIT=y
CONFIG_NETFILTER_XT_MATCH_MAC=y
CONFIG_NETFILTER_XT_MATCH_MARK=y
CONFIG_NETFILTER_XT_MATCH_MULTIPORT=y
CONFIG_NETFILTER_XT_MATCH_PKTTYPE=y
CONFIG_NETFILTER_XT_MATCH_POLICY=y
CONFIG_NETFILTER_XT_MATCH_QTAGUID=y
CONFIG_NETFILTER_XT_MATCH_QUOTA2_LOG=y
CONFIG_NETFILTER_XT_MATCH_QUOTA2=y
CONFIG_NETFILTER_XT_MATCH_QUOTA=y
CONFIG_NETFILTER_XT_MATCH_SOCKET=y
CONFIG_NETFILTER_XT_MATCH_STATE=y
CONFIG_NETFILTER_XT_MATCH_STATISTIC=y
CONFIG_NETFILTER_XT_MATCH_STRING=y
CONFIG_NETFILTER_XT_MATCH_TIME=y
CONFIG_NETFILTER_XT_MATCH_U32=y
CONFIG_NETFILTER_XT_TARGET_CLASSIFY=y
CONFIG_NETFILTER_XT_TARGET_CONNMARK=y
CONFIG_NETFILTER_XT_TARGET_IDLETIMER=y
CONFIG_NETFILTER_XT_TARGET_LOG=y
CONFIG_NETFILTER_XT_TARGET_MARK=y
CONFIG_NETFILTER_XT_TARGET_NFQUEUE=y
CONFIG_NETFILTER_XT_TARGET_NOTRACK=y
CONFIG_NETFILTER_XT_TARGET_SECMARK=y
CONFIG_NETFILTER_XT_TARGET_TCPMSS=y
CONFIG_NETFILTER_XT_TARGET_TPROXY=y
CONFIG_NETFILTER_XT_TARGET_TRACE=y
CONFIG_NETFILTER=y
CONFIG_NET_KEY=y
# CONFIG_NET_NS is not set
CONFIG_NET_SCHED=y
CONFIG_NET_SCH_HTB=y
CONFIG_NET_SCH_PRIO=y
CONFIG_NET=y
CONFIG_NF_CONNTRACK_AMANDA=y
CONFIG_NF_CONNTRACK_EVENTS=y
CONFIG_NF_CONNTRACK_FTP=y
CONFIG_NF_CONNTRACK_H323=y
CONFIG_NF_CONNTRACK_IPV4=y
CONFIG_NF_CONNTRACK_IPV6=y
CONFIG_NF_CONNTRACK_IRC=y
CONFIG_NF_CONNTRACK_NETBIOS_NS=y
CONFIG_NF_CONNTRACK_PPTP=y
CONFIG_NF_CONNTRACK_SANE=y
# CONFIG_NF_CONNTRACK_SIP is not set
CONFIG_NF_CONNTRACK_TFTP=y
CONFIG_NF_CONNTRACK=y
CONFIG_NFC_PN544=y
CONFIG_NF_CT_NETLINK=y
CONFIG_NF_CT_PROTO_DCCP=y
CONFIG_NF_CT_PROTO_SCTP=y
CONFIG_NF_CT_PROTO_UDPLITE=y
CONFIG_NF_NAT=y
CONFIG_NL80211_TESTMODE=y
CONFIG_NLS_ASCII=y
CONFIG_NLS_CODEPAGE_437=y
CONFIG_NLS_ISO8859_1=y
CONFIG_NLS_UTF8=y
CONFIG_NO_HZ=y
CONFIG_N_SMUX_LOOPBACK=y
CONFIG_N_SMUX=y
# CONFIG_OABI_COMPAT is not set
CONFIG_PACKET=y
CONFIG_PANIC_TIMEOUT=5
CONFIG_PARTITION_ADVANCED=y
CONFIG_PCI_MSI=y
CONFIG_PCI=y
CONFIG_PID_IN_CONTEXTIDR=y
# CONFIG_PID_NS is not set
CONFIG_PM8921_BMS=y
CONFIG_PM8921_CHARGER=y
CONFIG_PM_AUTOSLEEP=y
CONFIG_PMIC8XXX_FORCECRASH=y
CONFIG_PMIC8XXX_VIBRATOR=y
CONFIG_PM_RUNTIME=y
# CONFIG_PM_WAKELOCKS_GC is not set
CONFIG_PM_WAKELOCKS_LIMIT=0
CONFIG_PM_WAKELOCKS=y
CONFIG_POWER_SUPPLY=y
CONFIG_PPP_ASYNC=y
CONFIG_PPP_BSDCOMP=y
CONFIG_PPP_DEFLATE=y
CONFIG_PPP_FILTER=y
CONFIG_PPP_MPPE=y
CONFIG_PPP_MULTILINK=y
CONFIG_PPPOE=y
CONFIG_PPPOL2TP=y
CONFIG_PPPOLAC=y
CONFIG_PPPOPNS=y
CONFIG_PPP_SYNC_TTY=y
CONFIG_PPP=y
CONFIG_PREEMPT=y
CONFIG_PRIMA_WLAN_LFR=y
CONFIG_PRIMA_WLAN=m
CONFIG_PRIMA_WLAN_OKC=y
CONFIG_PRINTK_TIME=y
CONFIG_PROFILING=y
CONFIG_QSEECOM=y
CONFIG_RADIO_IRIS_TRANSPORT=m
CONFIG_RADIO_IRIS=y
CONFIG_RD_LZ4=y
CONFIG_REGULATOR_MSM_GPIO=y
CONFIG_REGULATOR_PM8XXX=y
CONFIG_RESOURCE_COUNTERS=y
CONFIG_RFKILL=y
CONFIG_RTC_CLASS=y
# CONFIG_RTC_DRV_MSM is not set
CONFIG_RTC_DRV_PM8XXX=y
CONFIG_RTC_SEMC_ETS=y
CONFIG_RT_GROUP_SCHED=y
CONFIG_RWSEM_XCHGADD_ALGORITHM=y
# CONFIG_SCHED_DEBUG is not set
CONFIG_SCHED_MC=y
CONFIG_SCHEDSTATS=y
CONFIG_SCSI_CONSTANTS=y
CONFIG_SCSI_LOGGING=y
CONFIG_SCSI_MULTI_LUN=y
CONFIG_SCSI_SCAN_ASYNC=y
CONFIG_SCSI_TGT=y
CONFIG_SCSI=y
CONFIG_SECURITYFS=y
CONFIG_SECURITY_NETWORK=y
CONFIG_SECURITY_SELINUX_AVC_EXTRA_INFO=y
CONFIG_SECURITY_SELINUX_BOOTPARAM=y
CONFIG_SECURITY_SELINUX=y
CONFIG_SECURITY=y
CONFIG_SENSORS_AKM8963=y
CONFIG_SENSORS_BMA250=y
CONFIG_SENSORS_EPM_ADC=y
CONFIG_SENSORS_MPU3050=y
CONFIG_SENSORS_PM8XXX_ADC=y
CONFIG_SENSORS_PM8XXX_PULLUP_100K_BLTHERM=y
CONFIG_SERIAL_MSM_HSL_CONSOLE=y
CONFIG_SERIAL_MSM_HSL=y
CONFIG_SERIAL_MSM_HS=y
CONFIG_SLIMBUS_MSM_CTRL=y
CONFIG_SLIP_COMPRESSED=y
CONFIG_SLIP_MODE_SLIP6=y
CONFIG_SLIP=y
# CONFIG_SLUB_DEBUG is not set
# CONFIG_SMP_ON_UP is not set
CONFIG_SMP=y
CONFIG_SMUX_CTL=y
# CONFIG_SND_ARM is not set
CONFIG_SND_DYNAMIC_MINORS=y
CONFIG_SND_SOC_DIFFERENTIAL_SPEAKER=y
CONFIG_SND_SOC_MSM8960=y
CONFIG_SND_SOC=y
# CONFIG_SND_SPI is not set
CONFIG_SND_USB_AUDIO=y
CONFIG_SND=y
CONFIG_SONY_CAM_V4L2=y
CONFIG_SONY_SSM=y
CONFIG_SONY_VPE=y
CONFIG_SOUND=y
CONFIG_SPI_QUP=y
CONFIG_SPI=y
CONFIG_SPS_SUPPORT_BAMDMA=y
CONFIG_SPS=y
CONFIG_STAGING=y
CONFIG_STRICT_MEMORY_RWX=y
CONFIG_SUSPEND_TIME=y
CONFIG_SWITCH=y
CONFIG_SW_SYNC=y
CONFIG_SYNC=y
CONFIG_SYSVIPC=y
CONFIG_TASK_IO_ACCOUNTING=y
CONFIG_TASKSTATS=y
CONFIG_TASK_XACCT=y
CONFIG_THERMAL_MONITOR=y
CONFIG_THERMAL_PM8XXX=y
CONFIG_THERMAL_TSENS8960=y
CONFIG_THERMAL=y
CONFIG_TIMER_STATS=y
CONFIG_TMPFS_POSIX_ACL=y
CONFIG_TMPFS=y
CONFIG_TOUCHSCREEN_CLEARPAD_I2C=y
CONFIG_TOUCHSCREEN_CLEARPAD_RMI_DEV=y
CONFIG_TOUCHSCREEN_CLEARPAD=y
CONFIG_TUN=y
CONFIG_UHID=y
CONFIG_UID_STAT=y
CONFIG_UIO_MSM_SHAREDMEM=y
CONFIG_UIO=y
CONFIG_UNIX=y
CONFIG_USB_ANDROID_NCM=y
CONFIG_USB_ANNOUNCE_NEW_DEVICES=y
CONFIG_USB_CI13XXX_MSM=y
CONFIG_USB_EHCI_EHSET=y
CONFIG_USB_EHCI_HCD=y
CONFIG_USB_EHCI_MSM_HOST4=y
CONFIG_USB_EHCI_MSM_HSIC=y
CONFIG_USB_EHCI_MSM=y
CONFIG_USB_EHSET_TEST_FIXTURE=y
# CONFIG_USB_GADGET_DEBUG_FILES is not set
CONFIG_USB_GADGET=y
CONFIG_USB_G_ANDROID=y
CONFIG_USB_HIDDEV=y
CONFIG_USB_HOST_EXTRA_NOTIFICATION=y
CONFIG_USB_HSIC_SMSC_HUB=y
CONFIG_USB_MIRRORLINK=y
CONFIG_USB_MSM_ACA_FORCE_DETECT_B_AS_A=y
CONFIG_USB_MSM_ACA=y
CONFIG_USB_NCP373=y
CONFIG_USB_NET_CDC_EEM=y
CONFIG_USB_OTG_WAKELOCK=y
# CONFIG_USB_NET_CDCETHER is not set
# CONFIG_USB_NET_CDC_NCM is not set
# CONFIG_USB_NET_CDC_SUBSET is not set
# CONFIG_USB_NET_CX82310_ETH is not set
# CONFIG_USB_NET_DM9601 is not set
# CONFIG_USB_NET_GL620A is not set
# CONFIG_USB_NET_INT51X1 is not set
# CONFIG_USB_NET_KALMIA is not set
# CONFIG_USB_NET_MCS7830 is not set
# CONFIG_USB_NET_NET1080 is not set
# CONFIG_USB_NET_PLUSB is not set
# CONFIG_USB_NET_SMSC75XX is not set
# CONFIG_USB_NET_SMSC95XX is not set
# CONFIG_USB_NET_ZAURUS is not set
CONFIG_USB_QCOM_DIAG_BRIDGE=y
CONFIG_USB_QCOM_IPC_BRIDGE=y
CONFIG_USB_QCOM_KS_BRIDGE=y
CONFIG_USB_QCOM_MDM_BRIDGE=y
CONFIG_USB_SERIAL_CSVT=y
CONFIG_USB_SERIAL=y
# CONFIG_USB_SIERRA_NET is not set
CONFIG_USB_STORAGE_ALAUDA=y
CONFIG_USB_STORAGE_CYPRESS_ATACB=y
CONFIG_USB_STORAGE_DATAFAB=y
# CONFIG_USB_STORAGE_DEBUG is not set
CONFIG_USB_STORAGE_FREECOM=y
CONFIG_USB_STORAGE_ISD200=y
CONFIG_USB_STORAGE_JUMPSHOT=y
CONFIG_USB_STORAGE_KARMA=y
CONFIG_USB_STORAGE_ONETOUCH=y
CONFIG_USB_STORAGE_SDDR09=y
CONFIG_USB_STORAGE_SDDR55=y
CONFIG_USB_STORAGE_USBAT=y
CONFIG_USB_STORAGE=y
CONFIG_USB_SUSPEND=y
CONFIG_USB_USBNET=y
CONFIG_USB=y
# CONFIG_USER_NS is not set
CONFIG_USER_RC_INPUT=y
# CONFIG_UTS_NS is not set
CONFIG_V4L_PLATFORM_DRIVERS=y
CONFIG_VFAT_FS_NO_DUALNAMES=y
CONFIG_VFAT_FS=y
CONFIG_VFP=y
CONFIG_VIDEOBUF2_MSM_MEM=y
CONFIG_VIDEO_DEV=y
CONFIG_VIDEO_HELPER_CHIPS_AUTO=y
CONFIG_VIDEO_V4L2_SUBDEV_API=y
CONFIG_VMALLOC_RESERVE=0x19000000
# CONFIG_VT is not set
CONFIG_WAKELOCK=y
CONFIG_WCD9304_CODEC=y
CONFIG_WCD9310_CODEC=y
CONFIG_WCNSS_CORE=y
CONFIG_WCNSS_MEM_PRE_ALLOC=y
CONFIG_XFRM_MIGRATE=y
CONFIG_XFRM_STATISTICS=y
CONFIG_XFRM_SUB_POLICY=y
CONFIG_XFRM_USER=y
```
